/* / {
    chosen {
        zmk,display = &display;
    };
}; */

&i2c0 {
    status = "okay";

    display: ssd1306@3c {
        compatible = "solomon,ssd1306fb";
        reg = <0x3c>;
        label = "DISPLAY";
        width = <128>;
        height = <32>;
        segment-remap;
        page-remap;
        prechargep = <0x22>;
        com-invdir;
        com-pins = <0x02>;
        contrast = <0xcf>;
        status = "okay";
    };
};
